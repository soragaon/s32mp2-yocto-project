## conf/local.conf
```bitbake
MACHINE = "stm32mp25-disco"
DISTRO = "stm32mp-headless"
PACKAGE_CLASSES = "package_deb"
CONF_VERSION = "2"
ACCEPT_EULA_stm32mp25-disco = "0"
BOOTSCHEME_LABELS = "optee"
BOOTDEVICE_LABELS = "sdcard"
WKS_IMAGE_FSTYPES = "wic wic.bz2 wic.bmap"
WKS_FILE = "${OPTEE_WIC_FILE}"
ST_BOOTFS = "1"
ST_USERFS = "1"
EXTRA_IMAGE_FEATURES = ""
BB_NUMBER_THREADS = "4"
PARALLEL_MAKE = "-j4"
BB_DISKMON_DIRS = "STOPTASKS,${TMPDIR},10G,100K HALT,${TMPDIR},2G,10K"
DL_DIR = "${TOPDIR}/../downloads"
SSTATE_DIR = "${TOPDIR}/../sstate-cache"
INHERIT += "rm_work"
PATCHRESOLVE = "noop"
GLIBC_GENERATE_LOCALES = "en_US.UTF-8"
# This host cannot resolve example.com; retain the sanity check on a reachable host.
CONNECTIVITY_CHECK_URIS = "https://github.com/"
```

## meta-headless/conf/distro/stm32mp-headless.conf
```bitbake
require conf/distro/openstlinux-weston.conf
DISTRO = "stm32mp-headless"
DISTRO_NAME = "STM32MP257F-DK headless Linux"
DISTRO_FEATURES:remove = "x11 wayland opengl vulkan opencl openvx kde splashscreen"
MACHINE_FEATURES:remove = "gpu openvx opencl vulkan splashscreen"
```

## meta-headless/conf/layer.conf
```bitbake
BBPATH .= ":${LAYERDIR}"
BBFILES += "${LAYERDIR}/recipes-*/*/*.bb ${LAYERDIR}/recipes-*/*/*.bbappend"
BBFILE_COLLECTIONS += "headless"
BBFILE_PATTERN_headless = "^${LAYERDIR}/"
BBFILE_PRIORITY_headless = "10"
LAYERDEPENDS_headless = "core st-openstlinux stm-st-stm32mp"
LAYERSERIES_COMPAT_headless = "scarthgap"
```
